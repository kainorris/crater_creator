## firmware/sdkconfig.defaults
```kconfig
# VL53L5CX init loads ~80KB firmware over I2C — needs extra stack
CONFIG_ESP_MAIN_TASK_STACK_SIZE=8192
CONFIG_EXAMPLE_I2C_SCL_GPIO=22
CONFIG_EXAMPLE_I2C_CLOCK_SPEED_HZ=40000
```
